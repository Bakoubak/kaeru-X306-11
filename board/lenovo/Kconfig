## board/lenovo/Kconfig
```kconfig
config LENOVO_AMAR_ROW_LTE
    bool "Support Lenovo Tab M10HD (2nd Gen) LTE"
    default n
    help
      Say Y if you want to include support for Lenovo Tab M10HD (2nd Gen) LTE

config LENOVO_AMAR_ROW_LTE-11
    bool "Support Lenovo Tab M10HD 2nd Gen"
    default n
    help
      Say Y if you want to include support for Lenovo Tab M10HD 2nd Gen
```

## configs/lenovo/amar_row_lte-11_defconfig
```kconfig
CONFIG_APP_ADDRESS=0x48022ddc
CONFIG_BOOTLOADER_BASE=0x48000000
CONFIG_BOOTLOADER_SIZE=0xBCF9C
CONFIG_BOOTMODE_ADDRESS=0x480bf5f0
CONFIG_DPRINTF_ADDRESS=0x4802E9E0
CONFIG_ENVIRONMENT_SUPPORT=y
CONFIG_FASTBOOT_FAIL_ADDRESS=0x48023864
CONFIG_FASTBOOT_INFO_ADDRESS=0x480237E4
CONFIG_FASTBOOT_OKAY_ADDRESS=0x48023A30
CONFIG_FASTBOOT_PUBLISH_ADDRESS=0x48023470
CONFIG_FASTBOOT_REGISTER_ADDRESS=0x48023434
CONFIG_GET_ENV_ADDRESS=0x48047228
CONFIG_FREE_ADDRESS=0x4802EE10
CONFIG_INIT_STORAGE_ADDRESS=0x48002770
CONFIG_INIT_STORAGE_CALLER=0x4800298C
CONFIG_LENOVO_AMAR_ROW_LTE-11=y
CONFIG_LK_LOG_STORE_ADDRESS=0x480409A0
CONFIG_MALLOC_ADDRESS=0x4802F658
CONFIG_MEDIATEK_MT6762=y
CONFIG_MTK_DETECT_KEY_ADDRESS=0x48004b14
CONFIG_PARTITION_GET_SIZE_BY_NAME_ADDRESS=0x48046f84
CONFIG_PARTITION_READ_ADDRESS=0x48048110
CONFIG_PLATFORM_INIT_ADDRESS=0x4800295C
CONFIG_PLATFORM_INIT_CALLER=0x4801ecc4
CONFIG_RECOVERY_CMDLINE1_ADDRESS=0x4809a80c
CONFIG_RECOVERY_CMDLINE_PATCH=y
CONFIG_SET_ENV_ADDRESS=0x480474ac
CONFIG_SPOOF_SUPPORT=y
CONFIG_THREAD_CREATE_ADDRESS=0x4801F480
CONFIG_THREAD_RESUME_ADDRESS=0x4801F694
CONFIG_VIDEO_PRINTF_ADDRESS=0x4802E6F0
```
